/* Linker Script Reference：https://sourceware.org/binutils/docs/ld/Scripts.html */






/* ******************************************************************************* */
/* 目标架构 */
OUTPUT_ARCH(riscv)
/* ******************************************************************************* */






/* ******************************************************************************* */
/* 执行入口 */
ENTRY(_start)
/* ******************************************************************************* */





/* ******************************************************************************* */
/* 数据存放起始地址 */
/* BASE_ADDRESS = 0x80200000; */

/* 2021-3-15 */
/*但为何一开始反汇编的结果就是0xffffffff80200000 ...我有的地方写错了位置*/
/* ANSWER I Have To make clean and objdump again to reset */
 /*修改为虚拟地址*/
 BASE_ADDRESS = 0xffffffff80200000;




SECTIONS
{
    /* '.' 表示当前地址--location counter */
    . = BASE_ADDRESS;
/* ******************************************************** */
    /* start 符号表示全部的开始位置 */
    kernel_start = .;
/* ******************************************************** */
    /* 2021-3-15 加入对齐 */
    . = ALIGN(4K);
    text_start = .;

    /* .text 字段 */
    .text : {
        /* 把 entry 函数放在最前面 [_start]*/
        *(.text.entry)
        /* 要链接的文件的 .text 字段集中放在这里 */
        *(.text .text.*)
    }

/* ******************************************************** */
     /* 2021-3-15 加入对齐 */
    . = ALIGN(4K);
    rodata_start = .;

    /* .rodata 字段 */
    .rodata : {
        /* 要链接的文件的 .rodata 字段集中放在这里 */
        *(.rodata .rodata.*)
    }

/* ******************************************************** */
    /* 2021-3-15 加入对齐 */
    . = ALIGN(4K);
    data_start = .;

    /* .data 字段 */
    .data : {
        /* 要链接的文件的 .data 字段集中放在这里 */
        *(.data .data.*)
    }

/* ******************************************************** */
    bss_start = .;

    /* .bss 字段 */
    .bss : {
        /* 要链接的文件的 .bss 字段集中放在这里 */
        *(.sbss .bss .bss.*)
    }
/* ******************************************************** */
    /* 结束地址 */
     /* 2021-3-15 加入对齐 */
    . = ALIGN(4K);
    kernel_end = .;
}


/* [*()表示各个文件所有符合要求的输入段凡在当前位置],[.为地址赋值由低到高] */
/* 2021-3-15 进行了虚拟地址的修改并数据段对齐到4KB， 否则若.rodata .data在一页还需分别标注读写属性 */
/* And I got to know that '//' not supported in [.ld] with Non-UTF-8 output: rust-lld: error: */
 



